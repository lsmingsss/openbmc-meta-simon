## conf/layer.conf
```bitbake
# We have a conf and classes directory, add to BBPATH
BBPATH .= ":${LAYERDIR}"

# We have recipes-* directories, add to BBFILES
BBFILES += "${LAYERDIR}/recipes-*/*/*.bb \
            ${LAYERDIR}/recipes-*/*/*.bbappend"

BBFILE_COLLECTIONS += "palmetto-simon-layer"
BBFILE_PATTERN_palmetto-simon-layer := "^${LAYERDIR}/"
LAYERSERIES_COMPAT_palmetto-simon-layer = "whinlatter walnascar"
```
